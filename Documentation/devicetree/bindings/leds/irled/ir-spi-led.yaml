## Documentation/devicetree/bindings/leds/irled/ir-spi-led.yaml
```yaml
# SPDX-License-Identifier: GPL-2.0-only OR BSD-2-Clause
%YAML 1.2
---
$id: http://devicetree.org/schemas/leds/irled/ir-spi-led.yaml#
$schema: http://devicetree.org/meta-schemas/core.yaml#

title: IR LED connected through SPI bus

maintainers:
  - Sean Young <sean@mess.org>

description:
  IR LED switch is connected to the MOSI line of the SPI device and the data
  is delivered through that.

properties:
  compatible:
    enum:
      - ir-spi-led
      - xiaomi,piano-ir-spi

  reg:
    maxItems: 1

  duty-cycle:
    $ref: /schemas/types.yaml#/definitions/uint8
    enum: [30, 50, 60, 70, 75, 80, 90]
    description:
      Percentage of one period in which the signal is active.

  led-active-low:
    type: boolean
    description:
      Output is negated with a NOT gate.

  power-supply: true

required:
  - compatible
  - reg

unevaluatedProperties: false

allOf:
  - $ref: /schemas/spi/spi-peripheral-props.yaml#
  - if:
      properties:
        compatible:
          const: xiaomi,piano-ir-spi
    then:
      description: |
        Piano uses SPI mode 0, a fixed 1.92 MHz sample clock and native
        MSB-first 32-bit words, with low-level spaces and 40 percent duty
        by default. The
        factory device has no described software-controlled IR supply.
        Runtime carrier and duty requests use the normal LIRC interface.
      properties:
        duty-cycle: false
        led-active-low: false
        power-supply: false
        spi-cpol: false
        spi-cpha: false
        spi-cs-high: false
        spi-lsb-first: false

examples:
  - |
    spi {
        #address-cells = <1>;
        #size-cells = <0>;

        irled@0 {
            compatible = "ir-spi-led";
            reg = <0x0>;

            duty-cycle = /bits/ 8 <60>;
            led-active-low;
            power-supply = <&irda_regulator>;
            spi-max-frequency = <5000000>;
        };
    };
```

## Documentation/devicetree/bindings/power/supply/southchip,sc8547a.yaml
```yaml
# SPDX-License-Identifier: (GPL-2.0-only OR BSD-2-Clause)
%YAML 1.2
---
$id: http://devicetree.org/schemas/power/supply/southchip,sc8547a.yaml#
$schema: http://devicetree.org/meta-schemas/core.yaml#

title: Southchip SC8547A switched-capacitor charge pump

maintainers:
  - yzddmr6 <46088090+yzddmr6@users.noreply.github.com>

description: |
  The SC8547A provides a 2:1 charging path with voltage and current ADCs,
  overvoltage and overcurrent protection, and a hardware watchdog. Parallel
  pumps can be managed by an external USB PD charging policy. The proprietary
  charging protocol PHY is not described by this binding.

properties:
  compatible:
    const: southchip,sc8547a

  reg:
    maxItems: 1

  interrupts:
    maxItems: 1

  io-channels:
    items:
      - description: Battery connector thermistor
      - description: USB connector thermistor

  io-channel-names:
    items:
      - const: battery-connector
      - const: usb-connector

  southchip,secondary:
    type: boolean
    description: Use the secondary pump switching configuration.

  southchip,battery-overvoltage-microvolt:
    description: Battery overvoltage protection threshold.
    minimum: 3500000
    maximum: 5075000
    multipleOf: 25000

  southchip,ac-overvoltage-microvolt:
    description: Adapter input overvoltage protection threshold.
    minimum: 11000000
    maximum: 17000000
    multipleOf: 1000000

  southchip,input-overvoltage-microvolt:
    description: Charge pump bus overvoltage protection threshold.
    minimum: 6000000
    maximum: 12350000
    multipleOf: 50000

  southchip,input-overcurrent-microamp:
    description: Charge pump bus overcurrent protection threshold.
    minimum: 1200000
    maximum: 5700000
    multipleOf: 300000

required:
  - compatible
  - reg
  - southchip,battery-overvoltage-microvolt
  - southchip,ac-overvoltage-microvolt
  - southchip,input-overvoltage-microvolt
  - southchip,input-overcurrent-microamp

allOf:
  - if:
      not:
        required:
          - southchip,secondary
    then:
      required:
        - interrupts
        - io-channels
        - io-channel-names

additionalProperties: false

examples:
  - |
    #include <dt-bindings/interrupt-controller/irq.h>

    i2c {
        #address-cells = <1>;
        #size-cells = <0>;

        charger@6f {
            compatible = "southchip,sc8547a";
            reg = <0x6f>;
            interrupt-parent = <&gpio>;
            interrupts = <163 IRQ_TYPE_EDGE_FALLING>;
            io-channels = <&adc 0x74c>, <&adc 0x747>;
            io-channel-names = "battery-connector", "usb-connector";
            southchip,battery-overvoltage-microvolt = <4850000>;
            southchip,ac-overvoltage-microvolt = <12000000>;
            southchip,input-overvoltage-microvolt = <10000000>;
            southchip,input-overcurrent-microamp = <4500000>;
        };
    };
```

## drivers/power/supply/ufcs/Kconfig
```kconfig
config OPLUS_UFCS_CLASS
	tristate "Oplus UFCS sink protocol and SC8547A PHY"
	select REGMAP
	default CHARGER_SC8547A
	help
	  Negotiate Universal Fast Charging Specification contracts over the
	  SC8547A PHY on boards where the charger driver registers it.

config OPLUS_UFCS_KUNIT_TEST
	bool "UFCS sink protocol test" if !KUNIT_ALL_TESTS
	depends on KUNIT && OPLUS_UFCS_CLASS=y
	select CRYPTO_LIB_SHA256
	default KUNIT_ALL_TESTS
```
