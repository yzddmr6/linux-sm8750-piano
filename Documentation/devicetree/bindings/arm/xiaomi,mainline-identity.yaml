## Documentation/devicetree/bindings/arm/xiaomi,mainline-identity.yaml
```yaml
# SPDX-License-Identifier: (GPL-2.0-only OR BSD-2-Clause)
%YAML 1.2
---
$id: http://devicetree.org/schemas/arm/xiaomi,mainline-identity.yaml#
$schema: http://devicetree.org/meta-schemas/core.yaml#

title: Root identity copy restored after Qualcomm ABL

maintainers:
  - Erwin <yzddmr7@gmail.com>

description:
  When Qualcomm ABL applies the stock DTBO of some boards, it copies
  the overlay's root model and compatible over those of the booted DTB. The
  board DTB keeps its own values in these root properties, which the DTBO
  does not carry, so that the OS can restore them early in boot.

select:
  properties:
    $nodename:
      const: '/'
  anyOf:
    - required:
        - xiaomi,mainline-compatible
    - required:
        - qcom,mainline-compatible

properties:
  $nodename:
    const: '/'

  qcom,mainline-compatible:
    $ref: /schemas/types.yaml#/definitions/string-array
    description: Copy of the root compatible defined by this DTB.

  qcom,mainline-model:
    $ref: /schemas/types.yaml#/definitions/string
    description: Copy of the root model defined by this DTB.

  xiaomi,mainline-compatible:
    $ref: /schemas/types.yaml#/definitions/string-array
    description: Copy of the root compatible defined by this DTB.

  xiaomi,mainline-model:
    $ref: /schemas/types.yaml#/definitions/string
    description: Copy of the root model defined by this DTB.

anyOf:
  - required:
      - xiaomi,mainline-compatible
  - required:
      - qcom,mainline-compatible

additionalProperties: true
```

## Documentation/devicetree/bindings/display/panel/novatek,nt36532.yaml
```yaml
# SPDX-License-Identifier: GPL-2.0-only OR BSD-2-Clause
%YAML 1.2
---
$id: http://devicetree.org/schemas/display/panel/novatek,nt36532.yaml#
$schema: http://devicetree.org/meta-schemas/core.yaml#

title: Novatek NT36532 based DSI display Panels

maintainers:
  - Junjie Cao <junjie.cao@linux.dev>

description: |
  The NT36532 IC from Novatek is a Driver IC used to drive MIPI-DSI panels.

allOf:
  - $ref: panel-common-dual.yaml#

properties:
  compatible:
    items:
      - enum:
          - csot,ppc100hb1-1
          - xiaomi,piano-nt36532
      - const: novatek,nt36532

  reg:
    maxItems: 1

  reset-gpios:
    maxItems: 1
    description: phandle of gpio for reset line - This should be 8mA

  id-gpios:
    maxItems: 1
    description:
      Input reading the panel module ID strap. The Xiaomi Pad 8 Pro ships
      two modules behind one board design; the level selects the module
      initialization, low for the CSOT 42-02-0a module and high for the
      BOE 35-02-0b module.

  vddio-supply:
    description: regulator that supplies the I/O voltage

  avdd-supply:
    description: positive LCD bias supply

  avee-supply:
    description: negative LCD bias supply

  ports: true

required:
  - compatible
  - reg
  - vddio-supply
  - reset-gpios
  - ports

if:
  properties:
    compatible:
      contains:
        const: xiaomi,piano-nt36532
then:
  required:
    - avdd-supply
    - avee-supply
    - id-gpios
else:
  properties:
    avdd-supply: false
    avee-supply: false
    id-gpios: false

unevaluatedProperties: false

examples:
  - |
    #include <dt-bindings/gpio/gpio.h>

    dsi {
        #address-cells = <1>;
        #size-cells = <0>;

        panel@0 {
            compatible = "csot,ppc100hb1-1", "novatek,nt36532";
            reg = <0>;

            reset-gpios = <&tlmm 133 GPIO_ACTIVE_LOW>;

            vddio-supply = <&vreg_l12b_1p8>;

            ports {
                #address-cells = <1>;
                #size-cells = <0>;

                port@0 {
                    reg = <0>;
                    panel_in_0: endpoint {
                        remote-endpoint = <&dsi0_out>;
                    };
                };

                port@1 {
                    reg = <1>;
                    panel_in_1: endpoint {
                        remote-endpoint = <&dsi1_out>;
                    };
                };
            };
        };
    };

  - |
    #include <dt-bindings/gpio/gpio.h>

    dsi {
        #address-cells = <1>;
        #size-cells = <0>;

        panel@0 {
            compatible = "xiaomi,piano-nt36532", "novatek,nt36532";
            reg = <0>;

            reset-gpios = <&tlmm 98 GPIO_ACTIVE_LOW>;
            id-gpios = <&tlmm 100 GPIO_ACTIVE_HIGH>;

            vddio-supply = <&vreg_l12b_1p8>;
            avdd-supply = <&panel_vsp>;
            avee-supply = <&panel_vsn>;

            ports {
                #address-cells = <1>;
                #size-cells = <0>;

                port@0 {
                    reg = <0>;
                    endpoint {
                        remote-endpoint = <&dsi0_out>;
                    };
                };

                port@1 {
                    reg = <1>;
                    endpoint {
                        remote-endpoint = <&dsi1_out>;
                    };
                };
            };
        };
    };

...
```

## Documentation/devicetree/bindings/firmware/gunyah-cma-mem.yaml
```yaml
# SPDX-License-Identifier: (GPL-2.0-only OR BSD-2-Clause)
%YAML 1.2
---
$id: http://devicetree.org/schemas/firmware/gunyah-cma-mem.yaml#
$schema: http://devicetree.org/meta-schemas/core.yaml#

title: Contiguous memory allocator for Virtual Machines

maintainers:
  - Prakruthi Deepak Heragu <quic_pheragu@quicinc.com>
  - Elliot Berman <quic_eberman@quicinc.com>

description: |+
  gunyah-cma-mem is a CMA memory manager that allows VMMs to use
  contiguous memory to backup Virtual Machines running on Gunyah. These
  regions are pre-defined by the firmware to have special attributes
  like memory encryption.

properties:
  compatible:
    const: gunyah-cma-vm-mem

  memory-region:
    minItems: 1
    maxItems: 2
    description: Reserved memory regions available for virtual machines.

  memory-region-names:
    minItems: 1
    maxItems: 2
    description: Names by which the VMM selects the reserved memory regions.

required:
  - compatible
  - memory-region
  - memory-region-names

additionalProperties: false

examples:
  - |
    gunyah-cma-mem {
        compatible = "gunyah-cma-vm-mem";
        memory-region = <&trust_ui_vm_mem>, <&oem_vm_mem>;
        memory-region-names = "trustedvm_cma" , "oemvm_cma";
    };
```

## Documentation/devicetree/bindings/input/nanosic,wn8030.yaml
```yaml
# SPDX-License-Identifier: (GPL-2.0-only OR BSD-2-Clause)
%YAML 1.2
---
$id: http://devicetree.org/schemas/input/nanosic,wn8030.yaml#
$schema: http://devicetree.org/meta-schemas/core.yaml#

title: Nanosic WN8030 detachable keyboard bridge

maintainers:
  - Erwin <yzddmr7@gmail.com>

description:
  An I2C bridge on the tablet connects a detachable keyboard folio. Its
  application is loaded into RAM before it supplies privately framed HID
  reports. This is not a standard HID-over-I2C device.

properties:
  compatible:
    const: xiaomi,piano-keyboard

  reg:
    const: 0x4c

  interrupts:
    minItems: 2
    maxItems: 2

  interrupt-names:
    items:
      - const: irq
      - const: wakeup

  reset-gpios:
    maxItems: 1
    description: Active-low bridge reset.

  wake-gpios:
    maxItems: 1
    description: Driven high to keep the bridge awake, low to allow sleep.

  vdd-supply:
    description: Nominal 3.3 V bridge supply.

  dvdd-supply:
    description: Nominal 1.8 V bridge supply.

  firmware-name:
    maxItems: 1
    description: Application firmware for this board, including its NANO IC header.

  wakeup-source: true

required:
  - compatible
  - reg
  - interrupts
  - interrupt-names
  - reset-gpios
  - wake-gpios
  - vdd-supply
  - dvdd-supply

additionalProperties: false

examples:
  - |
    #include <dt-bindings/gpio/gpio.h>
    #include <dt-bindings/interrupt-controller/irq.h>

    i2c {
        #address-cells = <1>;
        #size-cells = <0>;

        keyboard@4c {
            compatible = "xiaomi,piano-keyboard";
            reg = <0x4c>;
            interrupt-parent = <&tlmm>;
            interrupts = <97 IRQ_TYPE_EDGE_RISING>, <95 IRQ_TYPE_EDGE_RISING>;
            interrupt-names = "irq", "wakeup";
            reset-gpios = <&tlmm 188 GPIO_ACTIVE_LOW>;
            wake-gpios = <&tlmm 3 GPIO_ACTIVE_HIGH>;
            vdd-supply = <&keyboard_vdd>;
            dvdd-supply = <&keyboard_dvdd>;
            firmware-name = "nanosic/piano/MCU_Upgrade.bin";
        };
    };
```

## Documentation/devicetree/bindings/input/oneplus,pad2pro-pogo-keyboard.yaml
```yaml
# SPDX-License-Identifier: (GPL-2.0-only OR BSD-2-Clause)
%YAML 1.2
---
$id: http://devicetree.org/schemas/input/oneplus,pad2pro-pogo-keyboard.yaml#
$schema: http://devicetree.org/meta-schemas/core.yaml#

title: OnePlus Pad 2 Pro pogo pin keyboard

maintainers:
  - Erwin <yzddmr7@gmail.com>

description: |
  The OnePlus Pad 2 Pro, and the OPPO Pad 4 Pro built on the same board,
  accept a keyboard cover with a touchpad on a magnetic pogo pin connector.
  The keyboard's microcontroller exchanges framed packets with the tablet
  over one half-duplex data line: the transmit and receive pins of a tablet
  UART meet on that line through a direction switch, which the tablet
  enables only while it transmits, so the tablet receives its own
  transmissions back as well.

  The tablet switches the connector supply. While the supply is off, an
  attached keyboard pulls a separate sense line low; the tablet samples that
  line to decide when to power the connector, and learns from the silence of
  the powered keyboard that it has been removed.

  The touchpad coordinate range and resolution are fixed by the keyboard
  firmware, identical for every keyboard this tablet accepts, and implied by
  the compatible string; they are not board properties.

allOf:
  - $ref: /schemas/serial/serial-peripheral-props.yaml#

properties:
  compatible:
    const: oneplus,pad2pro-pogo-keyboard

  vdd-supply:
    description: Switched supply of the pogo pin connector.

  tx-enable-gpios:
    maxItems: 1
    description:
      Direction switch of the data line. While asserted, the UART transmit
      pin drives the line; while deasserted, the line belongs to the
      keyboard.

  detect-gpios:
    maxItems: 1
    description:
      Attachment sense line, asserted while a keyboard is attached. Only
      meaningful while vdd-supply is off.

  interrupts:
    maxItems: 1
    description: Edge on the attachment sense line when a keyboard attaches.

  wakeup-source: true

  current-speed:
    description: Line rate of the data line.
    default: 921600

required:
  - compatible
  - vdd-supply
  - tx-enable-gpios
  - detect-gpios
  - interrupts

unevaluatedProperties: false

examples:
  - |
    #include <dt-bindings/gpio/gpio.h>
    #include <dt-bindings/interrupt-controller/irq.h>

    serial {
        keyboard {
            compatible = "oneplus,pad2pro-pogo-keyboard";
            vdd-supply = <&pogo_vdd>;
            tx-enable-gpios = <&tlmm 83 GPIO_ACTIVE_HIGH>;
            detect-gpios = <&tlmm 96 GPIO_ACTIVE_LOW>;
            interrupts-extended = <&tlmm 96 IRQ_TYPE_EDGE_FALLING>;
            wakeup-source;
        };
    };
```

## Documentation/devicetree/bindings/input/touchscreen/novatek,nt36532e.yaml
```yaml
# SPDX-License-Identifier: (GPL-2.0-only OR BSD-2-Clause)
%YAML 1.2
---
$id: http://devicetree.org/schemas/input/touchscreen/novatek,nt36532e.yaml#
$schema: http://devicetree.org/meta-schemas/core.yaml#

title: Novatek NT36532E host-processed touch controller

maintainers:
  - Erwin <yzddmr7@gmail.com>

description:
  SPI controller with host-downloaded RAM firmware and raw sensor frames.
  The initial driver supports the cascade variant only. Touch power is shared
  with the panel. The panel phandle orders capture and firmware reload around
  the shared TDDI reset and power sequence.

allOf:
  - $ref: touchscreen.yaml#
  - $ref: /schemas/spi/spi-peripheral-props.yaml#

properties:
  compatible:
    const: novatek,nt36532e

  reg:
    maxItems: 1

  interrupts:
    maxItems: 1

  spi-max-frequency:
    maximum: 19200000

  spi-cpol: false
  spi-cpha: false

  firmware-name:
    minItems: 1
    maxItems: 2
    description:
      Board and panel-specific normal application firmware. With
      novatek,lcd-id-gpios the entry at the index of the ID level is used.

  novatek,lcd-id-gpios:
    maxItems: 1
    description:
      Input reading the panel module ID strap, low for the CSOT module and
      high for the BOE module on the Xiaomi Pad 8 Pro. It selects the
      firmware-name entry for the module.

required:
  - compatible
  - reg
  - interrupts
  - spi-max-frequency
  - firmware-name

if:
  properties:
    firmware-name:
      minItems: 2
then:
  required:
    - novatek,lcd-id-gpios

unevaluatedProperties: false

examples:
  - |
    #include <dt-bindings/gpio/gpio.h>
    #include <dt-bindings/interrupt-controller/irq.h>

    spi {
        #address-cells = <1>;
        #size-cells = <0>;

        touchscreen@0 {
            compatible = "novatek,nt36532e";
            reg = <0>;
            spi-max-frequency = <19200000>;
            interrupt-parent = <&tlmm>;
            interrupts = <162 IRQ_TYPE_EDGE_RISING>;
            novatek,lcd-id-gpios = <&tlmm 100 GPIO_ACTIVE_HIGH>;
            firmware-name = "novatek/piano/novatek_nt36532_piano_fw_csot.bin",
                            "novatek/piano/novatek_nt36532_piano_fw_boe.bin";
        };
    };
```

## Documentation/devicetree/bindings/input/touchscreen/novatek,nt36536-ts.yaml
```yaml
# SPDX-License-Identifier: (GPL-2.0-only OR BSD-2-Clause)
%YAML 1.2
---
$id: http://devicetree.org/schemas/input/touchscreen/novatek,nt36536-ts.yaml#
$schema: http://devicetree.org/meta-schemas/core.yaml#

title: Novatek NT36536 touchscreen controller

maintainers:
  - Erwin <yzddmr7@gmail.com>

description:
  The Novatek NT36536 is a touch and display driver integrated (TDDI)
  controller. Its display half is a novatek,nt36536 panel on the DSI bus;
  this binding describes its touch half, which is reached over SPI. The
  touch half has no supply or reset line of its own and no flash for its
  firmware. It is powered and reset together with the panel, and its
  firmware has to be downloaded again every time the panel is powered up.
  The panel node therefore owns the supplies and the reset line, and the
  touchscreen refers to the panel it follows.

allOf:
  - $ref: touchscreen.yaml#
  - $ref: /schemas/spi/spi-peripheral-props.yaml#

properties:
  compatible:
    const: novatek,nt36536-ts

  reg:
    maxItems: 1

  interrupts:
    maxItems: 1

  panel:
    description:
      The panel driven by the display half of the same controller.

  firmware-name:
    maxItems: 1
    description:
      Firmware image downloaded to the controller each time the panel is
      powered up.

  novatek,pen-support:
    type: boolean
    description:
      The sensor and the controller firmware also track an active stylus.
      The pen is reported in the same frame as touchscreen-size-x and
      touchscreen-size-y describe, with the same axis swap and inversion.

required:
  - compatible
  - reg
  - interrupts
  - panel
  - touchscreen-size-x
  - touchscreen-size-y

unevaluatedProperties: false

examples:
  - |
    #include <dt-bindings/interrupt-controller/irq.h>

    spi {
        #address-cells = <1>;
        #size-cells = <0>;

        touchscreen@0 {
            compatible = "novatek,nt36536-ts";
            reg = <0>;
            spi-max-frequency = <12000000>;
            interrupt-parent = <&tlmm>;
            interrupts = <162 IRQ_TYPE_EDGE_FALLING>;
            panel = <&panel>;
            firmware-name = "novatek/nt36536-xn242.bin";
            novatek,pen-support;
            touchscreen-size-x = <2400>;
            touchscreen-size-y = <3392>;
            touchscreen-swapped-x-y;
            touchscreen-inverted-x;
        };
    };

...
```
