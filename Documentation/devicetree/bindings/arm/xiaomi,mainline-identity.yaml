## Documentation/devicetree/bindings/power/supply/oplus,wls-charger-cps8601.yaml
```yaml
# SPDX-License-Identifier: (GPL-2.0-only OR BSD-2-Clause)
%YAML 1.2
---
$id: http://devicetree.org/schemas/power/supply/oplus,wls-charger-cps8601.yaml#
$schema: http://devicetree.org/meta-schemas/core.yaml#

title: Oplus CPS8601 wireless pen charger

maintainers:
  - yzddmr6 <46088090+yzddmr6@users.noreply.github.com>

description:
  Inductive transmitter for the stylus, powered by the ADSP-controlled hboost
  rail. The interrupt GPIO also serves as the firmware wake handshake line.

properties:
  compatible:
    const: oplus,wls-charger-cps8601

  reg:
    maxItems: 1

  int-gpios:
    maxItems: 1
    description: Interrupt and firmware wake handshake.

  sleep-gpios:
    maxItems: 1
    description: MCU sleep control.

  scan-gpios:
    maxItems: 1
    description: Receiver scan control.

  off-state-gpios:
    maxItems: 1
    description: Charge inhibit control.

  sw-en-gpios:
    maxItems: 1
    description: MCU supply switch enable.

  oplus,ocp-threshold:
    $ref: /schemas/types.yaml#/definitions/uint32
    description: Transmitter overcurrent threshold in the firmware register units.
    minimum: 1
    maximum: 3000

  oplus,ovp-threshold:
    $ref: /schemas/types.yaml#/definitions/uint32
    description: Transmitter overvoltage threshold in the firmware register units.
    minimum: 3000
    maximum: 20000

  oplus,lvp-threshold:
    $ref: /schemas/types.yaml#/definitions/uint32
    description: Transmitter undervoltage threshold in the firmware register units.
    minimum: 1
    maximum: 5000

  oplus,fod-threshold:
    $ref: /schemas/types.yaml#/definitions/uint32
    description: Foreign object detection threshold in the firmware register units.
    minimum: 1
    maximum: 65535

required:
  - compatible
  - reg
  - int-gpios
  - sleep-gpios
  - scan-gpios
  - off-state-gpios
  - sw-en-gpios
  - oplus,ocp-threshold
  - oplus,ovp-threshold
  - oplus,lvp-threshold
  - oplus,fod-threshold

additionalProperties: false
```

## Documentation/devicetree/bindings/power/supply/southchip,sc8547a.yaml
```yaml
# SPDX-License-Identifier: (GPL-2.0-only OR BSD-2-Clause)
%YAML 1.2
---
$id: http://devicetree.org/schemas/power/supply/southchip,sc8547a.yaml#
$schema: http://devicetree.org/meta-schemas/core.yaml#

title: Southchip SC8547A switched-capacitor charge pump

maintainers:
  - yzddmr6 <46088090+yzddmr6@users.noreply.github.com>

description: |
  The SC8547A provides a 2:1 charging path with voltage and current ADCs,
  overvoltage and overcurrent protection, and a hardware watchdog. Parallel
  pumps can be managed by an external USB PD charging policy. The proprietary
  charging protocol PHY is not described by this binding.

properties:
  compatible:
    const: southchip,sc8547a

  reg:
    maxItems: 1

  interrupts:
    maxItems: 1

  southchip,secondary:
    type: boolean
    description: Use the secondary pump switching configuration.

  southchip,battery-overvoltage-microvolt:
    description: Battery overvoltage protection threshold.
    minimum: 3500000
    maximum: 5075000
    multipleOf: 25000

  southchip,ac-overvoltage-microvolt:
    description: Adapter input overvoltage protection threshold.
    minimum: 11000000
    maximum: 17000000
    multipleOf: 1000000

  southchip,input-overvoltage-microvolt:
    description: Charge pump bus overvoltage protection threshold.
    minimum: 6000000
    maximum: 12350000
    multipleOf: 50000

  southchip,input-overcurrent-microamp:
    description: Charge pump bus overcurrent protection threshold.
    minimum: 1200000
    maximum: 5700000
    multipleOf: 300000

required:
  - compatible
  - reg
  - southchip,battery-overvoltage-microvolt
  - southchip,ac-overvoltage-microvolt
  - southchip,input-overvoltage-microvolt
  - southchip,input-overcurrent-microamp

allOf:
  - if:
      not:
        required:
          - southchip,secondary
    then:
      required:
        - interrupts

additionalProperties: false

examples:
  - |
    #include <dt-bindings/interrupt-controller/irq.h>

    i2c {
        #address-cells = <1>;
        #size-cells = <0>;

        charger@6f {
            compatible = "southchip,sc8547a";
            reg = <0x6f>;
            interrupt-parent = <&gpio>;
            interrupts = <163 IRQ_TYPE_EDGE_FALLING>;
            southchip,battery-overvoltage-microvolt = <4850000>;
            southchip,ac-overvoltage-microvolt = <12000000>;
            southchip,input-overvoltage-microvolt = <10000000>;
            southchip,input-overcurrent-microamp = <4500000>;
        };
    };
```

## Documentation/devicetree/bindings/power/supply/southchip,sc96231.yaml
```yaml
# SPDX-License-Identifier: (GPL-2.0-only OR BSD-2-Clause)
%YAML 1.2
---
$id: http://devicetree.org/schemas/power/supply/southchip,sc96231.yaml#
$schema: http://devicetree.org/meta-schemas/core.yaml#

title: Southchip SC96231 wireless pen transmitter

maintainers:
  - Erwin <yzddmr7@gmail.com>

description: |
  Wireless power transmitter with an I2C control interface. Hall sensors
  detect the magnetic pen attachment; the charging link reports the receiver
  battery level and Bluetooth address. The supply regulator owns voltage
  sequencing. The chip's installed firmware owns the wireless power protocol.

properties:
  compatible:
    const: southchip,sc96231
  reg:
    maxItems: 1
  interrupts:
    maxItems: 1
  vin-supply: true
  enable-gpios:
    maxItems: 1
    description: Transmitter enable signal.
  lp-enable-gpios:
    maxItems: 1
    description: Optional low-power control held asserted during operation.
  hall-gpios:
    items:
      - description: North pole Hall sensor 3
      - description: North pole Hall sensor 4
      - description: South pole Hall sensor 3
      - description: South pole Hall sensor 4
      - description: Pen placement error north pole sensor
      - description: Pen placement error south pole sensor
    description: Active-low magnetic attachment and placement error inputs.
  keyboard-gpios:
    items:
      - description: Keyboard folded over the front of the tablet
      - description: Keyboard folded over the back of the tablet
    description: Active-low keyboard position inputs used to reject its magnets.

required:
  - compatible
  - reg
  - interrupts
  - vin-supply
  - enable-gpios
  - hall-gpios
  - keyboard-gpios

additionalProperties: false

examples:
  - |
    #include <dt-bindings/gpio/gpio.h>
    #include <dt-bindings/interrupt-controller/irq.h>
    i2c {
        #address-cells = <1>;
        #size-cells = <0>;
        charger@38 {
            compatible = "southchip,sc96231";
            reg = <0x38>;
            vin-supply = <&pen_boost>;
            enable-gpios = <&tlmm 14 GPIO_ACTIVE_HIGH>;
            lp-enable-gpios = <&tlmm 99 GPIO_ACTIVE_HIGH>;
            hall-gpios = <&tlmm 200 GPIO_ACTIVE_LOW>,
                         <&tlmm 196 GPIO_ACTIVE_LOW>,
                         <&tlmm 201 GPIO_ACTIVE_LOW>,
                         <&tlmm 197 GPIO_ACTIVE_LOW>,
                         <&tlmm 55 GPIO_ACTIVE_LOW>,
                         <&tlmm 59 GPIO_ACTIVE_LOW>;
            keyboard-gpios = <&tlmm 80 GPIO_ACTIVE_LOW>,
                             <&tlmm 11 GPIO_ACTIVE_LOW>;
            interrupt-parent = <&tlmm>;
            interrupts = <78 IRQ_TYPE_EDGE_FALLING>;
        };
    };
```

## Documentation/devicetree/bindings/remoteproc/qcom,sm8750-soccp-pas.yaml
```yaml
# SPDX-License-Identifier: (GPL-2.0-only OR BSD-2-Clause)
%YAML 1.2
---
$id: http://devicetree.org/schemas/remoteproc/qcom,sm8750-soccp-pas.yaml#
$schema: http://devicetree.org/meta-schemas/core.yaml#

title: Qualcomm SM8750 SoC Control Processor Peripheral Authentication Service

maintainers:
  - Erwin <yzddmr7@gmail.com>

description:
  The SoCCP is authenticated through PAS. Its TCSR D-state register indicates
  when the loaded firmware can release the interconnect vote held during boot.

allOf:
  - $ref: /schemas/remoteproc/qcom,pas-common.yaml#

properties:
  compatible:
    const: qcom,sm8750-soccp-pas

  clocks:
    maxItems: 1

  clock-names:
    const: xo

  power-domains:
    maxItems: 2

  power-domain-names:
    items:
      - const: cx
      - const: mx

  interrupts:
    maxItems: 5

  interrupt-names:
    items:
      - const: wdog
      - const: fatal
      - const: ready
      - const: handover
      - const: stop-ack

  firmware-name:
    maxItems: 1

  memory-region:
    maxItems: 1

  interconnects:
    maxItems: 1

  qcom,smem-states:
    maxItems: 1

  qcom,smem-state-names:
    description: Name of the stop request state sent to SoCCP.
    maxItems: 1

  qcom,soccp-dstate:
    $ref: /schemas/types.yaml#/definitions/phandle-array
    description: TCSR syscon and byte offset of the SoCCP D-state register.
    items:
      - items:
          - description: TCSR syscon
          - description: Register offset

required:
  - compatible
  - power-domains
  - power-domain-names
  - memory-region
  - interconnects
  - qcom,soccp-dstate

unevaluatedProperties: false
```

## Documentation/devicetree/bindings/soc/qcom/qcom,smp2p-sleepstate.yaml
```yaml
# SPDX-License-Identifier: GPL-2.0-only OR BSD-2-Clause
%YAML 1.2
---
$id: http://devicetree.org/schemas/soc/qcom/qcom,smp2p-sleepstate.yaml#
$schema: http://devicetree.org/meta-schemas/core.yaml#

title: Qualcomm SMP2P sleep-state notifier

maintainers:
  - Bjorn Andersson <bjorn.andersson@linaro.org>

description:
  Some Qualcomm SoCs publish an SMP2P entry that the remote processors use
  to follow the sleep state of the application processor. The firmware
  writes the application processor awake indication into that entry.

  This driver owns the sleepstate SMP2P entry. It clears the awake
  indication when the system suspends and sets it again after the resume,
  and it keeps the inbound sleepstate interrupt as a wakeup source so that
  a remote initiated wake still reaches the power management core.

  The entry is an additional entry of an existing SMP2P edge, so the node
  refers to the outbound entry that carries the state and to the inbound
  entry that carries the interrupt.

properties:
  compatible:
    const: qcom,smp2p-sleepstate

  qcom,smem-states:
    $ref: /schemas/types.yaml#/definitions/phandle-array
    items:
      - description: phandle to the outbound SMP2P entry that carries the
          sleep state
      - description: index of the sleep state within that entry

  interrupt-parent:
    description: phandle to the inbound SMP2P entry that carries the
      sleepstate interrupt
    $ref: /schemas/types.yaml#/definitions/phandle

  interrupts:
    maxItems: 1

  interrupt-names:
    items:
      - const: smp2p-sleepstate-in

required:
  - compatible
  - qcom,smem-states
  - interrupt-parent
  - interrupts
  - interrupt-names

additionalProperties: false
```

## drivers/input/touchscreen/nt36536/Kconfig
```kconfig
#
# Novatek NT36536 touchscreen driver configuration
#
config TOUCHSCREEN_NT36536_SPI
	tristate "Novatek NT36536 no flash SPI driver"
	depends on SPI
	depends on DRM || DRM = n
	default n
	help
	  Say Y here if you have a Novatek NT36536 no flash touchscreen connected
	  to your system by SPI bus.
	  If unsure, say N.
```
