## Documentation/devicetree/bindings/media/qcom,sm8750-camss.yaml
```yaml
# SPDX-License-Identifier: (GPL-2.0 OR BSD-2-Clause)
%YAML 1.2
---
$id: http://devicetree.org/schemas/media/qcom,sm8750-camss.yaml#
$schema: http://devicetree.org/meta-schemas/core.yaml#

title: Qualcomm SM8750 Camera Subsystem (CAMSS)

maintainers:
  - Hangxiang Ma <hangxiang.ma@oss.qualcomm.com>

description:
  The CAMSS IP is a CSI decoder and ISP present on Qualcomm platforms.

properties:
  compatible:
    const: qcom,sm8750-camss

  reg:
    maxItems: 13

  reg-names:
    items:
      - const: csid0
      - const: csid1
      - const: csid2
      - const: csid_lite0
      - const: csid_lite1
      - const: csitpg0
      - const: csitpg1
      - const: csitpg2
      - const: vfe0
      - const: vfe1
      - const: vfe2
      - const: vfe_lite0
      - const: vfe_lite1

  clocks:
    maxItems: 23

  clock-names:
    items:
      - const: camnoc_nrt_axi
      - const: camnoc_rt_axi
      - const: cpas_ahb
      - const: cpas_fast_ahb
      - const: cpas_vfe0
      - const: cpas_vfe1
      - const: cpas_vfe2
      - const: cpas_vfe_lite
      - const: csid
      - const: csid_csiphy_rx
      - const: gcc_axi_hf
      - const: gcc_axi_sf
      - const: vfe0
      - const: vfe0_fast_ahb
      - const: vfe1
      - const: vfe1_fast_ahb
      - const: vfe2
      - const: vfe2_fast_ahb
      - const: vfe_lite
      - const: vfe_lite_ahb
      - const: vfe_lite_cphy_rx
      - const: vfe_lite_csid
      - const: qdss_debug_xo

  interrupts:
    maxItems: 10

  interrupt-names:
    items:
      - const: csid0
      - const: csid1
      - const: csid2
      - const: csid_lite0
      - const: csid_lite1
      - const: vfe0
      - const: vfe1
      - const: vfe2
      - const: vfe_lite0
      - const: vfe_lite1

  interconnects:
    maxItems: 4

  interconnect-names:
    items:
      - const: ahb
      - const: hf_mnoc
      - const: sf_mnoc
      - const: sf_icp_mnoc

  iommus:
    maxItems: 1

  power-domains:
    items:
      - description:
          IFE0 GDSC - Global Distributed Switch Controller for IFE0.
      - description:
          IFE1 GDSC - Global Distributed Switch Controller for IFE1.
      - description:
          IFE2 GDSC - Global Distributed Switch Controller for IFE2.
      - description:
          Titan GDSC - Global Distributed Switch Controller for the entire camss.
      - description: MMCX performance domain.
      - description: MX performance domain for the CSI receiver clocks.
      - description: MXC performance domain.

  power-domain-names:
    items:
      - const: ife0
      - const: ife1
      - const: ife2
      - const: top
      - const: mmcx
      - const: mx
      - const: mxc

  required-opps:
    description:
      Minimum performance states while CAMSS is active. The first four entries
      are empty because the GDSCs do not have performance states.
    items:
      - items:
          - const: 0
      - items:
          - const: 0
      - items:
          - const: 0
      - items:
          - const: 0
      - description: MMCX performance state.
      - description: MX performance state.
      - description: MXC performance state.

  ports:
    $ref: /schemas/graph.yaml#/properties/ports

    description:
      CSI input ports, one per CSIPHY. Each port connects to the output
      endpoint of a standalone CSI2 PHY provider.

    patternProperties:
      "^port@[0-5]$":
        $ref: /schemas/graph.yaml#/$defs/port-base
        unevaluatedProperties: false
        description:
          Input port for receiving CSI data from CSIPHY 0-5.

        properties:
          endpoint:
            $ref: video-interfaces.yaml#
            unevaluatedProperties: false

            properties:
              data-lanes:
                minItems: 1
                maxItems: 4
                items:
                  minimum: 1
                  maximum: 4

              bus-type:
                enum:
                  - 1 # MEDIA_BUS_TYPE_CSI2_CPHY
                  - 4 # MEDIA_BUS_TYPE_CSI2_DPHY

            required:
              - data-lanes

required:
  - compatible
  - reg
  - reg-names
  - clocks
  - clock-names
  - interrupts
  - interrupt-names
  - interconnects
  - interconnect-names
  - iommus
  - power-domains
  - power-domain-names
  - required-opps
  - ports

additionalProperties: false

examples:
  - |
    #include <dt-bindings/clock/qcom,sm8750-gcc.h>
    #include <dt-bindings/clock/qcom,sm8750-camcc.h>
    #include <dt-bindings/interconnect/qcom,icc.h>
    #include <dt-bindings/interconnect/qcom,sm8750-rpmh.h>
    #include <dt-bindings/interrupt-controller/arm-gic.h>
    #include <dt-bindings/power/qcom,rpmhpd.h>

    soc {
        #address-cells = <2>;
        #size-cells = <2>;

        isp@ad27000 {
            compatible = "qcom,sm8750-camss";

            reg = <0x0 0x0ad27000 0x0 0x2b00>,
                  <0x0 0x0ad2a000 0x0 0x2b00>,
                  <0x0 0x0ad2d000 0x0 0x2b00>,
                  <0x0 0x0ad6d000 0x0 0xa00>,
                  <0x0 0x0ad72000 0x0 0xa00>,
                  <0x0 0x0ad8b000 0x0 0x400>,
                  <0x0 0x0ad8c000 0x0 0x400>,
                  <0x0 0x0ad8d000 0x0 0x400>,
                  <0x0 0x0ac86000 0x0 0x10000>,
                  <0x0 0x0ac96000 0x0 0x10000>,
                  <0x0 0x0aca6000 0x0 0x10000>,
                  <0x0 0x0ad6e000 0x0 0x3000>,
                  <0x0 0x0ad73000 0x0 0x3000>;
            reg-names = "csid0",
                        "csid1",
                        "csid2",
                        "csid_lite0",
                        "csid_lite1",
                        "csitpg0",
                        "csitpg1",
                        "csitpg2",
                        "vfe0",
                        "vfe1",
                        "vfe2",
                        "vfe_lite0",
                        "vfe_lite1";

            clocks = <&camcc CAM_CC_CAMNOC_NRT_AXI_CLK>,
                     <&camcc CAM_CC_CAMNOC_RT_AXI_CLK>,
                     <&camcc CAM_CC_CAM_TOP_AHB_CLK>,
                     <&camcc CAM_CC_CAM_TOP_FAST_AHB_CLK>,
                     <&camcc CAM_CC_CAMNOC_RT_TFE_0_MAIN_CLK>,
                     <&camcc CAM_CC_CAMNOC_RT_TFE_1_MAIN_CLK>,
                     <&camcc CAM_CC_CAMNOC_RT_TFE_2_MAIN_CLK>,
                     <&camcc CAM_CC_CAMNOC_RT_IFE_LITE_CLK>,
                     <&camcc CAM_CC_CSID_CLK>,
                     <&camcc CAM_CC_CSID_CSIPHY_RX_CLK>,
                     <&gcc GCC_CAMERA_HF_AXI_CLK>,
                     <&gcc GCC_CAMERA_SF_AXI_CLK>,
                     <&camcc CAM_CC_TFE_0_MAIN_CLK>,
                     <&camcc CAM_CC_TFE_0_MAIN_FAST_AHB_CLK>,
                     <&camcc CAM_CC_TFE_1_MAIN_CLK>,
                     <&camcc CAM_CC_TFE_1_MAIN_FAST_AHB_CLK>,
                     <&camcc CAM_CC_TFE_2_MAIN_CLK>,
                     <&camcc CAM_CC_TFE_2_MAIN_FAST_AHB_CLK>,
                     <&camcc CAM_CC_IFE_LITE_CLK>,
                     <&camcc CAM_CC_IFE_LITE_AHB_CLK>,
                     <&camcc CAM_CC_IFE_LITE_CPHY_RX_CLK>,
                     <&camcc CAM_CC_IFE_LITE_CSID_CLK>,
                     <&camcc CAM_CC_QDSS_DEBUG_XO_CLK>;
            clock-names = "camnoc_nrt_axi",
                          "camnoc_rt_axi",
                          "cpas_ahb",
                          "cpas_fast_ahb",
                          "cpas_vfe0",
                          "cpas_vfe1",
                          "cpas_vfe2",
                          "cpas_vfe_lite",
                          "csid",
                          "csid_csiphy_rx",
                          "gcc_axi_hf",
                          "gcc_axi_sf",
                          "vfe0",
                          "vfe0_fast_ahb",
                          "vfe1",
                          "vfe1_fast_ahb",
                          "vfe2",
                          "vfe2_fast_ahb",
                          "vfe_lite",
                          "vfe_lite_ahb",
                          "vfe_lite_cphy_rx",
                          "vfe_lite_csid",
                          "qdss_debug_xo";

            interrupts = <GIC_SPI 601 IRQ_TYPE_EDGE_RISING>,
                         <GIC_SPI 603 IRQ_TYPE_EDGE_RISING>,
                         <GIC_SPI 431 IRQ_TYPE_EDGE_RISING>,
                         <GIC_SPI 605 IRQ_TYPE_EDGE_RISING>,
                         <GIC_SPI 376 IRQ_TYPE_EDGE_RISING>,
                         <GIC_SPI 433 IRQ_TYPE_EDGE_RISING>,
                         <GIC_SPI 436 IRQ_TYPE_EDGE_RISING>,
                         <GIC_SPI 457 IRQ_TYPE_EDGE_RISING>,
                         <GIC_SPI 606 IRQ_TYPE_EDGE_RISING>,
                         <GIC_SPI 377 IRQ_TYPE_EDGE_RISING>;
            interrupt-names = "csid0",
                              "csid1",
                              "csid2",
                              "csid_lite0",
                              "csid_lite1",
                              "vfe0",
                              "vfe1",
                              "vfe2",
                              "vfe_lite0",
                              "vfe_lite1";

            interconnects = <&gem_noc MASTER_APPSS_PROC QCOM_ICC_TAG_ACTIVE_ONLY
                             &config_noc SLAVE_CAMERA_CFG QCOM_ICC_TAG_ACTIVE_ONLY>,
                            <&mmss_noc MASTER_CAMNOC_HF QCOM_ICC_TAG_ALWAYS
                             &mc_virt SLAVE_EBI1 QCOM_ICC_TAG_ALWAYS>,
                            <&mmss_noc MASTER_CAMNOC_SF QCOM_ICC_TAG_ALWAYS
                             &mc_virt SLAVE_EBI1 QCOM_ICC_TAG_ALWAYS>,
                            <&mmss_noc MASTER_CAMNOC_NRT_ICP_SF QCOM_ICC_TAG_ALWAYS
                             &mc_virt SLAVE_EBI1 QCOM_ICC_TAG_ALWAYS>;
            interconnect-names = "ahb",
                                 "hf_mnoc",
                                 "sf_mnoc",
                                 "sf_icp_mnoc";

            iommus = <&apps_smmu 0x1c00 0x00>;

            power-domains = <&camcc CAM_CC_TFE_0_GDSC>,
                            <&camcc CAM_CC_TFE_1_GDSC>,
                            <&camcc CAM_CC_TFE_2_GDSC>,
                            <&camcc CAM_CC_TITAN_TOP_GDSC>,
                            <&rpmhpd RPMHPD_MMCX>,
                            <&rpmhpd RPMHPD_MX>,
                            <&rpmhpd RPMHPD_MXC>;
            power-domain-names = "ife0",
                                 "ife1",
                                 "ife2",
                                 "top",
                                 "mmcx",
                                 "mx",
                                 "mxc";
            required-opps = <0>, <0>, <0>, <0>,
                            <&rpmhpd_opp_nom>,
                            <&rpmhpd_opp_svs>,
                            <&rpmhpd_opp_nom>;

            ports {
                #address-cells = <1>;
                #size-cells = <0>;

                port@0 {
                    reg = <0>;

                    camss_csiphy0_inep0: endpoint {
                        data-lanes = <1 2 3 4>;
                        remote-endpoint = <&csiphy0_out>;
                    };
                };
            };

        };

        csiphy0: phy@ada9000 {
            compatible = "qcom,sm8750-csi2-phy";
            reg = <0x0 0x0ada9000 0x0 0x2000>;

            clocks = <&camcc CAM_CC_CSIPHY0_CLK>,
                     <&camcc CAM_CC_CSI0PHYTIMER_CLK>,
                     <&camcc CAM_CC_CORE_AHB_CLK>;
            clock-names = "core",
                          "timer",
                          "ahb";

            interrupts = <GIC_SPI 477 IRQ_TYPE_EDGE_RISING>;

            operating-points-v2 = <&csiphy_opp_table>;

            power-domains = <&camcc CAM_CC_TITAN_TOP_GDSC>,
                            <&rpmhpd RPMHPD_MMCX>,
                            <&rpmhpd RPMHPD_MX>,
                            <&rpmhpd RPMHPD_MXC>;
            power-domain-names = "top",
                                 "mmcx",
                                 "mx",
                                 "mxc";

            vdda-0p9-supply = <&vreg_0p9_supply>;
            vdda-1p2-supply = <&vreg_1p2_supply>;

            ports {
                #address-cells = <1>;
                #size-cells = <0>;

                port@0 {
                    reg = <0>;

                    csiphy0_in: endpoint {
                        data-lanes = <1 2 3 4>;
                        remote-endpoint = <&sensor_out>;
                    };
                };

                port@1 {
                    reg = <1>;

                    csiphy0_out: endpoint {
                        remote-endpoint = <&camss_csiphy0_inep0>;
                    };
                };
            };

            csiphy_opp_table: opp-table {
                compatible = "operating-points-v2";

                opp-266666667 {
                    opp-hz = /bits/ 64 <266666667>;
                    required-opps = <&rpmhpd_opp_low_svs_d1>,
                                    <&rpmhpd_opp_low_svs_d1>,
                                    <&rpmhpd_opp_low_svs_d1>;
                };
            };
        };
    };
```

## Documentation/devicetree/bindings/misc/xiaomi,piano-goodix-control.yaml
```yaml
# SPDX-License-Identifier: (GPL-2.0-only OR BSD-2-Clause)
%YAML 1.2
---
$id: http://devicetree.org/schemas/misc/xiaomi,piano-goodix-control.yaml#
$schema: http://devicetree.org/meta-schemas/core.yaml#

title: Xiaomi Piano secure Goodix fingerprint sensor control

maintainers:
  - slwyts <slwyts@foxmail.com>

description: |
  The sensor bus is owned by the secure world. The application processor
  controls sensor power and reset and receives a GPIO interrupt. Authentication
  commands are sent separately through Qualcomm QTEE. This device exposes no
  sensor register window.

properties:
  compatible:
    const: xiaomi,piano-goodix-control

  vdd-supply: true

  reset-gpios:
    maxItems: 1

  irq-gpios:
    maxItems: 1

required:
  - compatible
  - vdd-supply
  - reset-gpios
  - irq-gpios

additionalProperties: false
```

## Documentation/devicetree/bindings/net/bluetooth/qcom,wcn7860-bt.yaml
```yaml
# SPDX-License-Identifier: (GPL-2.0 OR BSD-2-Clause)
%YAML 1.2
---
$id: http://devicetree.org/schemas/net/bluetooth/qcom,wcn7860-bt.yaml#
$schema: http://devicetree.org/meta-schemas/core.yaml#

title: Qualcomm WCN7860 Bluetooth

maintainers:
  - Erwin <yzddmr7@gmail.com>

description:
  Bluetooth part of the WCN7860 (GANGES) package, attached over a UART. The
  package PMU (qcom,wcn7860-pmu) powers it; the supplies below are PMU
  outputs, and vddaon-supply associates the device with its power sequencer.

properties:
  compatible:
    enum:
      - qcom,wcn7860-bt

  vddaon-supply:
    description: VDD_AON supply regulator handle

  vddbtcx-supply:
    description: VDD_BTCX supply regulator handle

  vddbtcmx-supply:
    description: VDD_BTCMX supply regulator handle

  vddrfa0p9-supply:
    description: VDD_RFA_0P9 supply regulator handle

  vddrfa1p3-supply:
    description: VDD_RFA_1P3 supply regulator handle

  vddrfa1p9-supply:
    description: VDD_RFA_1P9 supply regulator handle

required:
  - compatible
  - vddaon-supply
  - vddbtcx-supply
  - vddbtcmx-supply
  - vddrfa0p9-supply
  - vddrfa1p3-supply
  - vddrfa1p9-supply

allOf:
  - $ref: bluetooth-controller.yaml#
  - $ref: qcom,bluetooth-common.yaml
  - $ref: /schemas/serial/serial-peripheral-props.yaml#

unevaluatedProperties: false

examples:
  - |
    serial {
        bluetooth {
            compatible = "qcom,wcn7860-bt";

            max-speed = <3200000>;
            vddaon-supply = <&vreg_pmu_aon_0p9>;
            vddbtcx-supply = <&vreg_pmu_btcx_0p9>;
            vddbtcmx-supply = <&vreg_pmu_btcmx_0p9>;
            vddrfa0p9-supply = <&vreg_pmu_rfa_0p9>;
            vddrfa1p3-supply = <&vreg_pmu_rfa_1p3>;
            vddrfa1p9-supply = <&vreg_pmu_rfa_1p9>;
        };
    };
```
