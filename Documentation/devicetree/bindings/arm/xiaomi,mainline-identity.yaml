## Documentation/devicetree/bindings/leds/backlight/kinetic,ktz8866.yaml
```yaml
# SPDX-License-Identifier: (GPL-2.0 OR BSD-2-Clause)
%YAML 1.2
---
$id: http://devicetree.org/schemas/leds/backlight/kinetic,ktz8866.yaml#
$schema: http://devicetree.org/meta-schemas/core.yaml#

title: Kinetic Technologies KTZ8866/KTZ8868 backlight

maintainers:
  - Jianhua Lu <lujianhua000@gmail.com>

description: |
  The Kinetic Technologies KTZ8866 is a high efficiency 6-channels-current-sinks
  led backlight with dual lcd bias power.
  https://www.kinet-ic.com/ktz8866/

  The KTZ8868 is register compatible with the KTZ8866. Its LCD bias outputs
  OUTP and OUTN are switched by the ENP and ENN pins. A board that wires those
  pins describes the outputs as the outp and outn regulators, so that the
  panel they supply can sequence them with its other supplies.

  Without a led child node the chip registers a backlight device. A KTZ8868
  may instead describe its LED string in a led child node, which the chip
  registers as an LED class device. This allows boards that light one panel
  from several chips to combine them in a single led-backlight device.

allOf:
  - $ref: common.yaml#
  - if:
      properties:
        compatible:
          contains:
            const: kinetic,ktz8866
    then:
      properties:
        led: false
        outn: false
        outp: false
  - if:
      properties:
        compatible:
          const: kinetic,ktz8868
    then:
      properties:
        kinetic,secondary: false
        kinetic,secondary-backlight: false
  - if:
      required:
        - led
    then:
      properties:
        current-num-sinks: false
        default-brightness: false
        max-brightness: false
        brightness-levels: false
        default-brightness-level: false

properties:
  compatible:
    enum:
      - kinetic,ktz8866
      - kinetic,ktz8868

  reg:
    maxItems: 1

  vddpos-supply:
    description: positive boost supply regulator.

  vddneg-supply:
    description: negative boost supply regulator.

  enable-gpios:
    description: GPIO to use to enable/disable the backlight (HWEN pin).
    maxItems: 1

  current-num-sinks:
    description:
      Number of the LED current sinks' channels, starting from LED1. Not used
      together with a led child node, whose led-sources selects the sinks.
    $ref: /schemas/types.yaml#/definitions/uint32
    enum: [1, 2, 3, 4, 5, 6]

  kinetic,current-ramp-delay-ms:
    description: |
      LED current ramping delay time in milliseconds, note that the
      case 1 will be mapped to 1μs.
    enum: [1, 2, 4, 8, 16, 32, 64, 128, 192, 256, 320, 384, 448, 512, 576, 640]

  kinetic,led-enable-ramp-delay-ms:
    description: |
      LED on/off ramping delay time in milliseconds, note that the case 0 will be
      mapped to 512μs because ktz8866 can't ramp faster than it.
    enum: [0, 1, 2, 4, 8, 16, 32, 64, 128, 256, 512, 1024, 2048, 4096, 8192, 16384]

  kinetic,enable-lcd-bias:
    description:
      Set if we want to output bias power supply for LCD. On the KTZ8868 this
      configures the bias section to follow the ENP and ENN pins; the outputs
      are then turned on and off through the outp and outn regulators.
    type: boolean

  kinetic,secondary-backlight:
    description:
      Second KTZ8866 driving the other LED strings of the same panel. It
      takes the configuration of this node and follows its brightness, so
      the panel has a single backlight device.
    $ref: /schemas/types.yaml#/definitions/phandle

  kinetic,secondary:
    description:
      This chip is programmed only through the chip that references it with
      kinetic,secondary-backlight and does not provide a backlight of its
      own. Its HWEN pin and supplies are those of that chip.
    type: boolean
  led:
    type: object
    $ref: /schemas/leds/common.yaml#
    unevaluatedProperties: false
    description:
      LED string driven by the current sinks, registered as an LED class
      device instead of a backlight device.

    properties:
      led-sources:
        description:
          Current sinks the LED string is connected to. Sinks LED1 to LED6
          are numbered 0 to 5.
        minItems: 1
        maxItems: 6
        items:
          maximum: 5

    required:
      - led-sources

patternProperties:
  "^out[np]$":
    type: object
    $ref: /schemas/regulator/regulator.yaml#
    unevaluatedProperties: false
    description:
      LCD bias output, OUTP (positive) or OUTN (negative), switched on and
      off by its enable pin.

    properties:
      enable-gpios:
        description: GPIO connected to the ENP (outp) or ENN (outn) pin.
        maxItems: 1

    required:
      - enable-gpios

dependencies:
  outn: [ 'kinetic,enable-lcd-bias' ]
  outp: [ 'kinetic,enable-lcd-bias' ]

required:
  - compatible
  - reg

if:
  required:
    - kinetic,secondary
then:
  properties:
    vddpos-supply: false
    vddneg-supply: false
    enable-gpios: false
    current-num-sinks: false
    kinetic,current-ramp-delay-ms: false
    kinetic,led-enable-ramp-delay-ms: false
    kinetic,enable-lcd-bias: false
    kinetic,secondary-backlight: false
    default-brightness: false
    max-brightness: false
else:
  if:
    properties:
      compatible:
        const: kinetic,ktz8866
  then:
    required:
      - enable-gpios
    dependentRequired:
      kinetic,enable-lcd-bias:
        - vddpos-supply
        - vddneg-supply

unevaluatedProperties: false

examples:
  - |
    #include <dt-bindings/gpio/gpio.h>

    i2c {
        #address-cells = <1>;
        #size-cells = <0>;

        backlight@11 {
            compatible = "kinetic,ktz8866";
            reg = <0x11>;
            vddpos-supply = <&bl_vddpos_5p5>;
            vddneg-supply = <&bl_vddneg_5p5>;
            enable-gpios = <&tlmm 139 GPIO_ACTIVE_HIGH>;
            current-num-sinks = <5>;
            kinetic,current-ramp-delay-ms = <128>;
            kinetic,led-enable-ramp-delay-ms = <1>;
            kinetic,enable-lcd-bias;
        };
    };
  - |
    #include <dt-bindings/gpio/gpio.h>

    i2c {
        #address-cells = <1>;
        #size-cells = <0>;

        backlight@11 {
            compatible = "kinetic,ktz8866";
            reg = <0x11>;
            enable-gpios = <&tlmm 2 GPIO_ACTIVE_HIGH>;
            current-num-sinks = <6>;
            kinetic,secondary-backlight = <&backlight_secondary>;
        };
    };

    i2c-1 {
        #address-cells = <1>;
        #size-cells = <0>;

        backlight_secondary: backlight@11 {
            compatible = "kinetic,ktz8866";
            reg = <0x11>;
            kinetic,secondary;
        };
    };
  - |
    #include <dt-bindings/gpio/gpio.h>
    #include <dt-bindings/leds/common.h>

    i2c {
        #address-cells = <1>;
        #size-cells = <0>;

        backlight@11 {
            compatible = "kinetic,ktz8868";
            reg = <0x11>;
            enable-gpios = <&tlmm 15 GPIO_ACTIVE_HIGH>;
            kinetic,enable-lcd-bias;

            led {
                function = LED_FUNCTION_BACKLIGHT;
                color = <LED_COLOR_ID_WHITE>;
                led-sources = <0 1 2 4 5>;
            };

            outn {
                regulator-name = "lcd_vsn";
                enable-gpios = <&tlmm 14 GPIO_ACTIVE_HIGH>;
            };

            outp {
                regulator-name = "lcd_vsp";
                enable-gpios = <&tlmm 111 GPIO_ACTIVE_HIGH>;
            };
        };
    };
```

## Documentation/devicetree/bindings/media/i2c/chipnext,cn3927.yaml
```yaml
# SPDX-License-Identifier: (GPL-2.0-only OR BSD-2-Clause)
%YAML 1.2
---
$id: http://devicetree.org/schemas/media/i2c/chipnext,cn3927.yaml#
$schema: http://devicetree.org/meta-schemas/core.yaml#

title: Chipnext CN3927 voice coil lens actuator

maintainers:
  - Erwin <46088090+yzddmr6@users.noreply.github.com>

description:
  The CN3927 controls a camera lens voice coil through a 10-bit DAC
  and an I2C control interface.

properties:
  compatible:
    const: chipnext,cn3927

  reg:
    maxItems: 1

  vio-supply:
    description: I/O supply, 1.8 V.

  vaf-supply:
    description: Voice coil supply, 2.8 V.

required:
  - compatible
  - reg
  - vio-supply
  - vaf-supply

additionalProperties: false

examples:
  - |
    i2c {
        #address-cells = <1>;
        #size-cells = <0>;
        lens@c {
            compatible = "chipnext,cn3927";
            reg = <0x0c>;
            vio-supply = <&camera_vio>;
            vaf-supply = <&camera_vaf>;
        };
    };
```

## Documentation/devicetree/bindings/media/i2c/ovti,ov32d40.yaml
```yaml
# SPDX-License-Identifier: (GPL-2.0-only OR BSD-2-Clause)
%YAML 1.2
---
$id: http://devicetree.org/schemas/media/i2c/ovti,ov32d40.yaml#
$schema: http://devicetree.org/meta-schemas/core.yaml#

title: OmniVision OV32D40 image sensor

maintainers:
  - yzddmr6 <46088090+yzddmr6@users.noreply.github.com>

description:
  The OV32D40 is a 32 megapixel sensor controlled over I2C with a four-lane
  MIPI CSI-2 output. The supported mode uses a 19.2 MHz external clock.

allOf:
  - $ref: /schemas/media/video-interface-devices.yaml#

properties:
  compatible:
    const: ovti,ov32d40

  reg:
    maxItems: 1

  clocks:
    maxItems: 1

  power-domains:
    maxItems: 1
    description: Power domain required for the sensor master clock.

  reset-gpios:
    maxItems: 1
    description: Active low sensor reset.

  avdd-supply:
    description: Analog supply, 2.8 V.

  dvdd-supply:
    description: Digital core supply, 1.2 V.

  vddio-supply:
    description: Digital I/O supply, 1.8 V.

  port:
    $ref: /schemas/graph.yaml#/$defs/port-base
    additionalProperties: false

    properties:
      endpoint:
        $ref: /schemas/media/video-interfaces.yaml#
        unevaluatedProperties: false

        properties:
          data-lanes:
            items:
              - const: 1
              - const: 2
              - const: 3
              - const: 4

          link-frequencies:
            maxItems: 1

        required:
          - data-lanes
          - link-frequencies

required:
  - compatible
  - reg
  - clocks
  - reset-gpios
  - avdd-supply
  - dvdd-supply
  - vddio-supply
  - port

unevaluatedProperties: false
```

## Documentation/devicetree/bindings/media/i2c/smartsens,sc1300cs.yaml
```yaml
# SPDX-License-Identifier: (GPL-2.0-only OR BSD-2-Clause)
%YAML 1.2
---
$id: http://devicetree.org/schemas/media/i2c/smartsens,sc1300cs.yaml#
$schema: http://devicetree.org/meta-schemas/core.yaml#

title: SmartSens SC1300CS 13-megapixel CMOS image sensor

maintainers:
  - Erwin <46088090+yzddmr6@users.noreply.github.com>

description:
  The SC1300CS is a RAW image sensor with an I2C control interface
  and a MIPI CSI-2 output. The supported configuration uses four D-PHY
  data lanes and a 19.2 MHz input clock.

allOf:
  - $ref: /schemas/media/video-interface-devices.yaml#

properties:
  compatible:
    const: smartsens,sc1300cs

  reg:
    maxItems: 1

  clocks:
    maxItems: 1

  avdd-supply:
    description: Analogue supply, 2.8 V.

  dvdd-supply:
    description: Digital core supply, 1.2 V.

  dovdd-supply:
    description: Digital I/O supply, 1.8 V.

  reset-gpios:
    description: Active-low reset signal.
    maxItems: 1

  port:
    $ref: /schemas/graph.yaml#/$defs/port-base
    additionalProperties: false
    properties:
      endpoint:
        $ref: /schemas/media/video-interfaces.yaml#
        unevaluatedProperties: false
        properties:
          data-lanes:
            items:
              - const: 1
              - const: 2
              - const: 3
              - const: 4
          link-frequencies:
            maxItems: 1
        required:
          - data-lanes
          - link-frequencies

required:
  - compatible
  - reg
  - clocks
  - avdd-supply
  - dvdd-supply
  - dovdd-supply
  - reset-gpios
  - port

unevaluatedProperties: false

examples:
  - |
    #include <dt-bindings/gpio/gpio.h>

    i2c {
        #address-cells = <1>;
        #size-cells = <0>;

        camera@36 {
            compatible = "smartsens,sc1300cs";
            reg = <0x36>;
            clocks = <&camera_clk>;
            assigned-clocks = <&camera_clk>;
            assigned-clock-rates = <19200000>;
            avdd-supply = <&camera_avdd>;
            dvdd-supply = <&camera_dvdd>;
            dovdd-supply = <&camera_dovdd>;
            reset-gpios = <&gpio 7 GPIO_ACTIVE_LOW>;
            port {
                endpoint {
                    remote-endpoint = <&csi_in>;
                    data-lanes = <1 2 3 4>;
                    link-frequencies = /bits/ 64 <600000000>;
                };
            };
        };
    };
```

## Documentation/devicetree/bindings/media/i2c/smartsens,sc820cs.yaml
```yaml
# SPDX-License-Identifier: (GPL-2.0-only OR BSD-2-Clause)
%YAML 1.2
---
$id: http://devicetree.org/schemas/media/i2c/smartsens,sc820cs.yaml#
$schema: http://devicetree.org/meta-schemas/core.yaml#

title: SmartSens SC820CS 8-megapixel CMOS image sensor

maintainers:
  - Erwin <46088090+yzddmr6@users.noreply.github.com>

description:
  The SC820CS is a RAW image sensor with an I2C control interface
  and a MIPI CSI-2 output. The supported configuration uses four D-PHY
  data lanes and a 24 MHz input clock.

allOf:
  - $ref: /schemas/media/video-interface-devices.yaml#

properties:
  compatible:
    const: smartsens,sc820cs

  reg:
    maxItems: 1

  clocks:
    maxItems: 1

  avdd-supply:
    description: Analogue supply, 2.8 V.

  dvdd-supply:
    description: Digital core supply, 1.2 V.

  dovdd-supply:
    description: Digital I/O supply, 1.8 V.

  reset-gpios:
    description: Active-low reset signal.
    maxItems: 1

  port:
    $ref: /schemas/graph.yaml#/$defs/port-base
    additionalProperties: false
    properties:
      endpoint:
        $ref: /schemas/media/video-interfaces.yaml#
        unevaluatedProperties: false
        properties:
          data-lanes:
            items:
              - const: 1
              - const: 2
              - const: 3
              - const: 4
          link-frequencies:
            maxItems: 1
        required:
          - data-lanes
          - link-frequencies

required:
  - compatible
  - reg
  - clocks
  - avdd-supply
  - dvdd-supply
  - dovdd-supply
  - reset-gpios
  - port

unevaluatedProperties: false

examples:
  - |
    #include <dt-bindings/gpio/gpio.h>

    i2c {
        #address-cells = <1>;
        #size-cells = <0>;

        camera@20 {
            compatible = "smartsens,sc820cs";
            reg = <0x20>;
            clocks = <&camera_clk>;
            assigned-clocks = <&camera_clk>;
            assigned-clock-rates = <24000000>;
            avdd-supply = <&camera_avdd>;
            dvdd-supply = <&camera_dvdd>;
            dovdd-supply = <&camera_dovdd>;
            reset-gpios = <&gpio 7 GPIO_ACTIVE_LOW>;
            port {
                endpoint {
                    remote-endpoint = <&csi_in>;
                    data-lanes = <1 2 3 4>;
                    link-frequencies = /bits/ 64 <368000000>;
                };
            };
        };
    };
```
